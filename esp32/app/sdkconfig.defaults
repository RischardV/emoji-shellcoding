## esp32/app/sdkconfig.defaults
```kconfig
CONFIG_IDF_TARGET="esp32c3"
CONFIG_COMPILER_OPTIMIZATION_SIZE=y
CONFIG_ESPTOOLPY_FLASHSIZE_4MB=y
CONFIG_LOG_DEFAULT_LEVEL_WARN=y
CONFIG_BOOTLOADER_LOG_LEVEL_WARN=y
# CONFIG_APP_COMPILE_TIME_DATE is not set
# CONFIG_ESP_SYSTEM_MEMPROT_FEATURE is not set
# CONFIG_BOOTLOADER_REGION_PROTECTION_ENABLE is not set
```
